# TC37XPD register map
Vendor: Infineon; Series: ATVMC; File version: 100
Default
CPU: other r0p0, little endian, MPU, FPU, vendor SysTick, 4 interrupt priority bits
Registers are 32-bit, read-write, reset 0x0 unless marked. A register's access mark holds for its fields unless they carry their own. Offsets are from the block's base; lines under a group give offsets from that group; [hi:lo] are bit positions; {n}, {i} and the like mark numbered series; 'fields as' and 'values as' point back to an identical list; <NAME> marks a mode.

## Memory map
0xA8080000 PFI0 size 0x43064 — PFI
0xA8380000 PFI1 size 0x43064 — PFI
0xF0000000 FCE size 0x200
0xF0000400 CBS blocks up to offset 0x200
{0xF0000600+0x100*n} ASCLIN{n} size 0x100 (n=0..9)
0xF0001000 STM0 size 0x100 — STM
0xF0001100 STM1 size 0x100 — STM
0xF0001200 STM2 size 0x100 — STM
0xF0001800 GPT120 size 0x100 — GPT12
0xF0001C00 QSPI0 size 0x100 — QSPI
0xF0001D00 QSPI1 size 0x100 — QSPI
0xF0001E00 QSPI2 size 0x100 — QSPI
0xF0001F00 QSPI3 size 0x100 — QSPI
0xF0002000 QSPI4 size 0x100 — QSPI
0xF0002600 MSC0 size 0x100 — MSC
0xF0002700 MSC1 size 0x100 — MSC
0xF0002A00 CCU60 size 0x100 — CCU6
0xF0002B00 CCU61 size 0x100 — CCU6
0xF0003000 SENT size 0xABC
0xF0005000 PSI5 size 0xB00
0xF0007000 PSI5S size 0x3E4
0xF0010000 DMA size 0x3000
0xF001C000 ERAY0 size 0x900 — ERAY
0xF001D000 GETH size 0x2054
0xF0020000 EVADC size 0x3C04
0xF0024000 EDSADC size 0x700
0xF0025000 CONVCTRL size 0xEC — CONVERTER
0xF0030000 SBCU blocks up to offset 0x100 — FPI Bus Control Unit
0xF0035000 IOM size 0x200
0xF0036000 SCU size 0x400 — System Control Unit
0xF0036800 SMU size 0x800
0xF0037000 INT blocks up to offset 0x240
0xF0038000 SRC size 0xFF8
0xF003A000 P00 size 0x100 — General Purpose I O Ports and Peripheral I O Lines
0xF003A100 P01 size 0x100 — General Purpose I O Ports and Peripheral I O Lines
0xF003A200 P02 size 0x100 — General Purpose I O Ports and Peripheral I O Lines
0xF003AA00 P10 size 0x100 — General Purpose I O Ports and Peripheral I O Lines
0xF003AB00 P11 size 0x100 — General Purpose I O Ports and Peripheral I O Lines
0xF003AC00 P12 size 0x100 — General Purpose I O Ports and Peripheral I O Lines
0xF003AD00 P13 size 0x100 — General Purpose I O Ports and Peripheral I O Lines
0xF003AE00 P14 size 0x100 — General Purpose I O Ports and Peripheral I O Lines
0xF003AF00 P15 size 0x100 — General Purpose I O Ports and Peripheral I O Lines
0xF003B400 P20 size 0x100 — General Purpose I O Ports and Peripheral I O Lines
0xF003B500 P21 size 0x100 — General Purpose I O Ports and Peripheral I O Lines
0xF003B600 P22 size 0x100 — General Purpose I O Ports and Peripheral I O Lines
0xF003B700 P23 size 0x100 — General Purpose I O Ports and Peripheral I O Lines
0xF003C000 P32 size 0x100 — General Purpose I O Ports and Peripheral I O Lines
0xF003C100 P33 size 0x100 — General Purpose I O Ports and Peripheral I O Lines
0xF003C200 P34 size 0x100 — General Purpose I O Ports and Peripheral I O Lines
0xF003C800 P40 size 0x100 — General Purpose I O Ports and Peripheral I O Lines
0xF0040000 HSM blocks up to offset 0x20000 — Hardware Security Module
0xF0060000 MTU size 0x7000
0xF0080000 HSSL0 size 0x100 — HSSL
0xF0090000 HSCT0 size 0x10000 — HSCT
0xF00C0000 I2C0 size 0x10020 — I2C
0xF0100000 GTM size 0xF5000
0xF0200000 CAN0 size 0x9100 — CAN
0xF0210000 CAN1 size 0x9100 — CAN
0xF0248000 PMS size 0x200
0xF02C0A00 ASCLIN10 size 0x100
0xF02C0B00 ASCLIN11 size 0x100
0xF8030000 FSI blocks up to offset 0x8
0xF8038000 PMU blocks up to offset 0x52C
0xF8040000 DMU blocks up to offset 0x30044
0xF8500000 DAM0 size 0x158 — DAM
0xF8508000 AMU00 size 0x1B0 — AMU
0xF8508100 AMU01 size 0x1B0 — AMU
0xF8508400 ADMA0 size 0x2F4 — ADMA
0xF8700000 DOM0 size 0x4FC — DOM
0xF8800000 CPU0 size 0x1FFC0 — CPU
0xF8820000 CPU1 size 0x1FFC0 — CPU
0xF8840000 CPU2 size 0x1FFC0 — CPU
0xFB718000 MINIMCDS size 0x3020

## Licence text in the file
***************************************************************************** * * Copyright (C) 2024 Infineon Technologies AG. All rights reserved. * * Infineon Technologies AG (Infineon) is supplying this software for use with * Infineon's microcontrollers. This file can be freely distributed within * development tools that are supporting such microcontrollers. * * THIS SOFTWARE IS PROVIDED "AS IS". NO WARRANTIES, WHETHER EXPRESS, IMPLIED * OR STATUTORY, INCLUDING, BUT NOT LIMITED TO, IMPLIED WARRANTIES OF * MERCHANTABILITY AND FITNESS FOR A PARTICULAR PURPOSE APPLY TO THIS SOFTWARE. * INFINEON SHALL NOT, IN ANY CIRCUMSTANCES, BE LIABLE FOR SPECIAL, INCIDENTAL, * OR CONSEQUENTIAL DAMAGES, FOR ANY REASON WHATSOEVER. * ******************************************************************************
